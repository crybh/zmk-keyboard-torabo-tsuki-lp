## dts/bindings/zmk,input-processor-zip-xy-scale.yaml
```yaml
# SPDX-License-Identifier: MIT

description: |
  Simple REL_X/REL_Y scaling input processor.
  Multiplies incoming XY deltas by scale-q8. 256 == 1.0.

compatible: "zmk,input-processor-zip-xy-scale"

properties:
  "#input-processor-cells":
    type: int
    required: true
    const: 0

  scale-q8:
    type: int
    default: 256
    description: |
      Scale value in Q8 fixed-point. 256 = 1.0, 128 = 0.5, 512 = 2.0.

input-processor-cells: []
```
